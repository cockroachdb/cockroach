## build/release/bincheck/buildroot/configs/qemu_x86_64_glibc_defconfig
```kconfig
# Configuration derived from upstream qemu_x86_64_defconfig.

# Architecture.
BR2_x86_64=y

# Toolchain.
BR2_TOOLCHAIN_EXTERNAL=y

# System.
BR2_SYSTEM_BIN_SH_BASH=y
BR2_SYSTEM_DHCP="eth0"
BR2_TARGET_GENERIC_GETTY_PORT="tty1"

# Filesystem.
BR2_TARGET_ROOTFS_INITRAMFS=y
BR2_ROOTFS_OVERLAY="$(BR2_EXTERNAL_COCKROACH_BINCHECK_PATH)/board/qemu/common/fs-overlay"
BR2_ROOTFS_POST_BUILD_SCRIPT="$(BR2_EXTERNAL_COCKROACH_BINCHECK_PATH)/board/qemu/common/post-build.sh"

# Kernel.
BR2_LINUX_KERNEL=y
BR2_LINUX_KERNEL_USE_CUSTOM_CONFIG=y
BR2_LINUX_KERNEL_CUSTOM_CONFIG_FILE="$(BR2_EXTERNAL_COCKROACH_BINCHECK_PATH)/board/qemu/x86_64_glibc/linux.config"

# Userland.
BR2_PACKAGE_BUSYBOX_SHOW_OTHERS=y
BR2_PACKAGE_OPENSSH=y
BR2_PACKAGE_NCURSES_TERMLIB=y
```
